## conf/distro/include/systemd-as-default.inc
```bitbake
INIT_MANAGER = "systemd"

DISTRO_FEATURES:append = " systemd"
VIRTUAL-RUNTIME_init_manager = "systemd"
DISTRO_FEATURES_BACKFILL_CONSIDERED:append = " sysvinit"
VIRTUAL-RUNTIME_initscripts = ""
```

## conf/layer.conf
```bitbake
BBPATH =. "${LAYERDIR}:"
BBFILES += "${LAYERDIR}/recipes-*/*/*.bb ${LAYERDIR}/recipes-*/*/*.bbappend"
BBFILE_COLLECTIONS += "dbl"
BBFILE_PATTERN_dbl = "^${LAYERDIR}/"
BBFILE_PRIORITY_dbl = "10"

LAYERVERSION_dbl = "1"

#BBFILES += "${@' '.join('${LAYERDIR}/dynamic-layers/%s/recipes-*/*/*.bbappend' % layer \
#               for layer in BBFILE_COLLECTIONS.split())}"
#BBFILES += "${@' '.join('${LAYERDIR}/dynamic-layers/%s/recipes-*/*/*.bb' % layer \
#               for layer in BBFILE_COLLECTIONS.split())}"

BBFILES_DYNAMIC += " \
    qt5-layer:${LAYERDIR}/dynamic-layers/qt5-layer/recipes-*/*/*.bb \
    qt5-layer:${LAYERDIR}/dynamic-layers/qt5-layer/recipes-*/*/*.bbappend \
    qt6-layer:${LAYERDIR}/dynamic-layers/qt6-layer/recipes-*/*/*.bb \
    qt6-layer:${LAYERDIR}/dynamic-layers/qt6-layer/recipes-*/*/*.bbappend \
"

LAYERSERIES_COMPAT_dbl = "kirkstone scarthgap"

LICENSE_PATH += "${LAYERDIR}/licenses"
```
